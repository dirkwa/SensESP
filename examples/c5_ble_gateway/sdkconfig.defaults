## examples/c5_ble_gateway/sdkconfig.defaults
```kconfig
# ESP32-C5 BLE gateway — pure ESP-IDF build

# Flash
CONFIG_ESPTOOLPY_FLASHSIZE_16MB=y
CONFIG_ESPTOOLPY_FLASHSIZE="16MB"

# PSRAM — Waveshare C5 has 8MB octal PSRAM
CONFIG_SPIRAM=y
CONFIG_SPIRAM_MODE_OCT=y
CONFIG_SPIRAM_SPEED_80M=y

# BLE — Bluedroid with legacy scan
CONFIG_BT_ENABLED=y
CONFIG_BT_BLUEDROID_ENABLED=y
CONFIG_BT_BLE_ENABLED=y
CONFIG_BT_BLE_42_FEATURES_SUPPORTED=y
CONFIG_BT_CLASSIC_ENABLED=n

# WiFi
CONFIG_ESP_WIFI_ENABLED=y

# Partition table
CONFIG_PARTITION_TABLE_CUSTOM=y
CONFIG_PARTITION_TABLE_CUSTOM_FILENAME="c5_partitions.csv"
```

## examples/p4_c6_ota_updater/sdkconfig.defaults
```kconfig
# Match the Waveshare ESP32-P4-WIFI6-POE-ETH board's 16 MB SPI flash.
CONFIG_ESPTOOLPY_FLASHSIZE_16MB=y
CONFIG_ESPTOOLPY_FLASHSIZE="16MB"

# Custom partition table from min_spiffs.csv (copied into project root).
CONFIG_PARTITION_TABLE_CUSTOM=y
CONFIG_PARTITION_TABLE_CUSTOM_FILENAME="min_spiffs.csv"

# Enable Arduino-ESP32's built-in ESP-Hosted + NimBLE BLE integration so
# esp32-hal-hosted.c (which provides hostedInitBLE / hostedHasUpdate /
# hostedBeginUpdate / hostedWriteUpdate / hostedEndUpdate /
# hostedActivateUpdate) gets compiled into the build.
CONFIG_ESP_HOSTED_ENABLE_BT_NIMBLE=y

CONFIG_LOG_DEFAULT_LEVEL_INFO=y
```

## examples/p4_esp_hosted_probe/sdkconfig.defaults
```kconfig
# Project-specific IDF sdkconfig overrides.
#
# esp32-arduino requires a 1000 Hz FreeRTOS tick. The default IDF
# config sets it to 100 Hz, which breaks the Arduino core's timing
# assumptions at link time.
CONFIG_FREERTOS_HZ=1000

# Match the Waveshare ESP32-P4-WIFI6-POE-ETH board's 16 MB SPI flash.
# Without this, IDF defaults to 2 MB and warns at configure time.
CONFIG_ESPTOOLPY_FLASHSIZE_16MB=y
CONFIG_ESPTOOLPY_FLASHSIZE="16MB"

# Use a custom partition table from min_spiffs.csv (same layout as the
# Arduino default for this board, copied into the project root).
CONFIG_PARTITION_TABLE_CUSTOM=y
CONFIG_PARTITION_TABLE_CUSTOM_FILENAME="min_spiffs.csv"

# Enable Arduino-ESP32's built-in ESP-Hosted + NimBLE BLE integration.
# This activates esp32-hal-hosted.c which ships hostedInitBLE() — it
# handles SDIO pin config (from the variant's BOARD_SDIO_ESP_HOSTED_*
# macros), esp_hosted_init(), esp_hosted_connect_to_slave(), and
# esp_hosted_bt_controller_init/enable(). Without this define,
# esp32-hal-hosted.c compiles to nothing.
CONFIG_ESP_HOSTED_ENABLE_BT_NIMBLE=y

# Verbose info logs during first-boot probing so we can see what the
# esp_hosted stack is doing during init.
CONFIG_LOG_DEFAULT_LEVEL_INFO=y
```
